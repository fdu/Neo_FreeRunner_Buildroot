## omhacks/Config.in
```kconfig
config BR2_PACKAGE_OMHACKS
  bool "omhacks"
  help
    It is a fast and simple library of common openmoko utility functions.
```

## wmiconfig/Config.in
```kconfig
config BR2_PACKAGE_WMICONFIG
  bool "wmiconfig"
  help
    wmiconfig is a tool written by Atheros Communications Inc to configure the Ar6k WIFI chip used in the Neo Freerunner.
```
